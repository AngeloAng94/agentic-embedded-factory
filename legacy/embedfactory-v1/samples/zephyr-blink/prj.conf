## CMakeLists.txt
```
# EmbedFactory reference Zephyr application.
#
# This is the stock Zephyr application boilerplate: `west build` exports
# ZEPHYR_BASE for the cmake process it spawns, so find_package(Zephyr) resolves
# the Zephyr build system without any extra configuration.
cmake_minimum_required(VERSION 3.20.0)

find_package(Zephyr REQUIRED HINTS $ENV{ZEPHYR_BASE})
project(embedfactory_reference)

target_sources(app PRIVATE src/main.c)
```

## prj.conf
```kconfig
# EmbedFactory reference project — deliberately minimal and portable.
# Only generic Zephyr features are enabled so the same source builds for any
# upstream board (native_sim on the host, or an ARM board with the Zephyr SDK).
CONFIG_PRINTK=y
CONFIG_SERIAL=y
CONFIG_CONSOLE=y

CONFIG_MAIN_STACK_SIZE=2048
```

## src/main.c
```c
/*
 * EmbedFactory reference firmware (Zephyr).
 *
 * This is the minimal, board-agnostic application the runner really compiles
 * to prove the vertical slice works with a real toolchain. It deliberately
 * avoids devicetree aliases, drivers and board-specific headers so it builds
 * unchanged for:
 *
 *   - native_sim        (host build, no cross toolchain needed)
 *   - qemu_cortex_m3    (ARM, needs the Zephyr SDK)
 *   - nucleo_l476rg     (real ARM hardware, needs the Zephyr SDK)
 *
 * A successful build produces build/zephyr/zephyr.elf and, for ARM boards,
 * build/zephyr/zephyr.bin and build/zephyr/zephyr.hex.
 */

#include <zephyr/kernel.h>
#include <zephyr/sys/printk.h>

int main(void)
{
	printk("EmbedFactory reference firmware starting\n");

	while (1) {
		printk("uptime: %lld ms\n", (long long)k_uptime_get());
		k_sleep(K_SECONDS(1));
	}

	return 0;
}
```
